const bool DB[36][8] = {
    {1, 1, 1, 1, 1, 1, 0, 0}, // 0
    {0, 1, 1, 0, 0, 0, 0, 0}, // 1
    {1, 1, 0, 1, 1, 0, 1, 0}, // 2
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    {0, 0, 0, 0, 0, 0, 0, 1}, // Z NA
};

const int PIN[8] = {6, 7, 9, 2, 3, 5, 4, 8};

void show(char chr)
{
    int id;
    if (chr >= '0' && chr <= '9')
    {
        id = chr - 48;
    }
    else if (chr >= 'A' && chr <= 'Z')
    {
        id = chr - 55;
    }
    else if (chr >= 'a' && chr <= 'z')
    {
        id = chr - 87;
    }
    else // error
    {
        return;
    }

    Serial.print(chr);
    Serial.print(' ');
    Serial.println(id);

    for (int i = 0; i < 8; i++)
    {
        digitalWrite(PIN[i], DB[id][i]);
    }
}

void setup()
{
    Serial.begin(230400);
    for (int i = 0; i < 8; i++)
    {
        pinMode(PIN[i], OUTPUT);
    }
}

void loop()
{

    String str = "Hello";
    int d = 500;
    for (char chr : str)
    {
        show(chr);
        delay(d);
    }
}