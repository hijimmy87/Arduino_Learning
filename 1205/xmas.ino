#include <math.h>

const int PIN[] = {2, 3, 4};
const double BEAT = 1000;

int pitchs[3][95] = {
    {62, 71, 69, 67, 62, 62, 71, 69, 67, 64, 64, 72, 71,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 69, 67},
    {55, 0, 0, 0, 55, 55, 0, 0, 0, 55, 55, 0, 0,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 0, 55},
    {59, 0, 0, 0, 59, 59, 0, 0, 0, 60, 60, 0, 0,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 0, 59}};
double durations[] = {0.125, 0.125, 0.125, 0.125, 0.5, 0.125, 0.125, 0.125, 0.125, 0.5, 0.125, 0.125, 0.125,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 0.125, 0.5};
int notes = sizeof(durations) / sizeof(double);

int pitch2freq(int p)
{
    if (p == 0)
        return 0;
    return round(440.0 * pow(2.0, (p - 69) / 12.0));
}

void setup()
{
    Serial.begin(230400);
    Serial.println(notes);
    for (int j = 0; j < 3; j++)
        pinMode(PIN[j], OUTPUT);
}

void loop()
{
    for (int i = 0; i < notes; i++)
    {
        int d = durations[i] * BEAT;
        for (int j = 0; j < 5; j++)
            tone(PIN[j], pitch2freq(pitchs[j][i]), d);
        delay(d * 1.375);
        for (int j = 0; j < 5; j++)
            noTone(PIN[j]);
    }
    delay(5000);
}